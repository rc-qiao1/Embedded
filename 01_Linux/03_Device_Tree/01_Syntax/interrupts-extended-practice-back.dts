/dts-v1/;

/ {

	interrupt-controller {
		compatible = "practice,gic";
		interrupt-controller;
		#interrupt-cells = <0x03>;
		phandle = <0x01>;
	};

	interrupt-controller-1 {
		compatible = "practice,gpio-intc";
		interrupt-controller;
		#interrupt-cells = <0x02>;
		phandle = <0x02>;
	};

	device {
		compatible = "practice,device";
		interrupts-extended = <0x01 0x00 0x2a 0x04 0x02 0x07 0x02>;
	};
};
